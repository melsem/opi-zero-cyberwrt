
&spdif {
	/delete-property/ pinctrl-names;
	/delete-property/ pinctrl-0;
	status = "disabled";
};

/ {
	leds {
		status_led {
			/delete-property/ status;
		};
	};

	/delete-node/ spdif-out;
	/delete-node/ sound_spdif;
};
