
&pio {
	pps_pins: pps_pins {
		pins = "PA7", "PA6";
		function = "gpio_in";
	};
};

/ {
	pps {
		compatible = "pps-gpio";
		pinctrl-names = "default";
		pinctrl-0 = <&pps_pins>;
		gpios = <&pio 0 7 0>;
		echo-gpios = <&pio 0 6 0>;
		assert-falling-edge;
		echo-active-ms = <100>;
		status = "okay";
	};
};

