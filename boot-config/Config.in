## boot-config/Config.in
```kconfig
menu "Select editor 'boot-config' Options to add the ability to edit the overlay."
	depends on PACKAGE_boot-config
	comment "boot-config compilation overlay options."

	config overlays
		bool "Enable edit-add overlays"
		default y
		help
			Enable overlay editor (enable ready-made examples, add a new one).

	config overlay_1wire
		bool "Add 1-Wire gpio10 PA10"
		default y
		help
			Include a working example: 1-Wire "Overlay" in the download list.

	config overlay_pps
		bool "Add pps gpio7 PA7"
		default y
		help
			Include a working example: pps "Overlay" in the download list.

	config overlay_gpio_keys_user
		bool "Add gpio_keys_user PA13-PA14-PA15-PA16-PA2"
		default y
		help
			Include a working example: gpio_keys_user "Overlay" in the download list.

	config overlay_rotary_encoder
		bool "Add rotary_button-PA0 rotary_encoder-PA1-PA3"
		default y
		help
			Enable working example Overlay rotate_button-PA0, rotate_encoder-PA1-PA3 into the load list.

	config overlay_i2c4
		bool "Add i2c4 sda-gpio18 PA18, scl-gpio19 PA19"
		default n
		help
			Enable working example "Overlay": i2c4 sda-gpio18 PA18, scl-gpio19 PA19 into the load list.
endmenu
menu "Select boot-config Web Control is a custom Web UI for boot-config."
	depends on PACKAGE_boot-config
	comment "Custom Web UI for boot-config."

	config boot-config-luci-web-control
		bool "Luci Web UI for boot-config."
		select PACKAGE_uhttpd
		default y

	config boot-config-cyberwrt-web-control
		bool "Cyberwrt Web UI for boot-config."
		select PACKAGE_uhttpd
		default y
endmenu
```

## web-radio2/Config.in
```kconfig
if PACKAGE_web-radio2

choice
	prompt "Select Web Variant"
	default WEB_RADIO2_MODERN
	help
	  Choose which file variant should be installed into the firmware.

	config WEB_RADIO2_CLASSIC
		bool "Install web File classic (Standard)"

	config WEB_RADIO2_MODERN
		bool "Install web File modern (Alternative)"

endchoice

endif
```

## wiringOP-Zero/Config.in
```kconfig
menu "Selecting the Orangepi model to which the assembly is WiringOP-zero..."
	depends on PACKAGE_wiringOP-Zero

config ORANGEPI_ZERO_H2_PLUS
	bool "Enable target orangepi-zero-h2+"
	default y
	help
           This 26-pin headers, and 13pin function interface.

config ORANGEPI_ZERO_PLUS
	bool "Enable target orangepi-zero-plus-h5"
	default n
	help
           This 26-pin headers, and 13pin function interface.

config ORANGEPI_R1_H2_PLUS
	bool "Enable target orangepi-R1-h2+"
	default n
	help
           This 26-pin headers, and 13pin function interface.

config ORANGEPI_PC_H3
	bool "Enable target orangepi-pc-h3"
	default n
	help
           This 40-pin headers.

config ORANGEPI_PC_PLUS_H3
	bool "Enable target orangepi-pc-plus-h3"
	default n
	help
           This 40-pin headers.

config ORANGEPI_PLUS_H3
	bool "Enable target orangepi-plus-h3"
	default n
	help
           This 40-pin headers.

config ORANGEPI_PLUS_2E_H3
	bool "Enable target orangepi-plus-2e-h3"
	default n
	help
           This 40-pin headers.

config ORANGEPI_ONE_H3
	bool "Enable target orangepi-one-h3"
	default n
	help
           This 40-pin headers.

config ORANGEPI_LITE_H3
	bool "Enable target orangepi-lite-h3"
	default n
	help
           This 40-pin headers.

config ORANGEPI_ZERO_PLUS2_H3
	bool "Enable target orangepi-zero-plus2-h3"
	default n
	help
           This 26-pin headers, and 13pin function interface.

config ORANGEPI_ZERO_PLUS2_H5
	bool "Enable target orangepi-zero-plus2-h5"
	default n
	help
           This 26-pin headers, and 13pin function interface.

config ORANGEPI_LITE_2
	bool "Enable target orangepi-lite2"
	default n
	help
           This 26-pin headers

config ORANGE_PI_WIN
	bool "Enable target orangepi-win"
	default n
	help
           This 40-pin headers.

config ORANGEPI_PC2
	bool "Enable target orangepi-pc2"
	default n
	help
           This 40-pin headers.

config ORANGEPI_PRIME
	bool "Enable target orangepi-prime"
	default n
	help
           This 40-pin headers.

config ORANGEPI_3
	bool "Enable target orangepi-3"
	default n
	help
           This 26-pin headers

endmenu

menu "Include in Examples build"
	depends on PACKAGE_wiringOP-Zero
config EXAMPLES
	bool "Examples"
	default n
	help
		Examples.
endmenu

menu "Include in library build. - (/usr/include/*.h)"
	depends on PACKAGE_wiringOP-Zero
config INCLUDE_LIB_WIRINGOP
	bool "include"
	default n
	help
	   Include in library build. - (/usr/include/*.h).
endmenu

menu "Include in SHARE_MAN1 build"
	depends on PACKAGE_wiringOP-Zero
config SHARE_MAN1
	bool "Share-man1"
	default n
	help
		Share-man.
endmenu
```
